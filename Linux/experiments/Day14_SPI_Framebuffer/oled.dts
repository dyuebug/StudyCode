/*
 * Day14 设备树片段（i.MX6ULL ECSPI1 + SSD1306）
 *
 * 注意：
 *   - reg = <0> 对应第 0 根片选
 *   - dc-gpios 是 OLED 的命令/数据选择脚
 *   - spi-max-frequency 不要超过模块与走线能力
 */

&ecspi1 {
	pinctrl-names = "default";
	pinctrl-0 = <&pinctrl_ecspi1>;
	fsl,spi-num-chipselects = <2>;
	cs-gpios = <&gpio4 26 GPIO_ACTIVE_LOW>, <&gpio4 24 GPIO_ACTIVE_LOW>;
	status = "okay";

	oled: oled {
		compatible = "100ask,oled";
		reg = <0>;
		spi-max-frequency = <1000000>;
		dc-gpios = <&gpio4 20 GPIO_ACTIVE_LOW>;
	};
};
